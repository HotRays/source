## package/kernel/bh174x/src/Kconfig
```kconfig
config ROHM_BH1749
        tristate "Rohm BH174x Color Sensor support"
        depends on I2C
        help
          Say yes here to enable support for the Rohm BH1749 Color & IR Sensors.

config ROHM_BH1745
        tristate "Rohm BH1745 Color Sensor support"
        depends on I2C
        help
          Say yes here to enable support for the Rohm BH1745 Color Sensors.
```

## package/kernel/leds-aw9523b/src/Kconfig
```kconfig
config LEDS_AW9523B
        tristate "AWININC aw9523b LED support"
        depends on I2C
        help
          Say yes here to enable support for the awininc aw9523b i2c LEDs.
```
